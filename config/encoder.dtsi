#include <behaviors.dtsi>

/ {
    rgb_encoder: rgb_encoder {
        compatible = "zmk,behavior-sensor-rotate";
        #sensor-binding-cells = <0>;
        bindings = <&rgb_ug RGB_BRI>, <&rgb_ug RGB_BRD>;
        tap-ms = <20>;
    };
    
    vol_encoder: vol_encoder {
        compatible = "zmk,behavior-sensor-rotate";
        #sensor-binding-cells = <0>;
        bindings = <&kp C_VOL_DOWN>, <&kp C_VOL_UP>;
        tap-ms = <20>;
    };
};